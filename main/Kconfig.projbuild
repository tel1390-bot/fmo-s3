## main/Kconfig.projbuild
```kconfig
menu "FMO Live Monitor"

config FMO_WIFI_SSID
    string "Wi-Fi SSID"
    default ""
    help
        The 2.4 GHz Wi-Fi network used by AI Passport. Keep the tracked default
        empty and configure the real value in the untracked sdkconfig file.

config FMO_WIFI_PASSWORD
    string "Wi-Fi password"
    default ""
    help
        Password for the selected Wi-Fi network. Open networks may leave this
        empty. Never commit a populated sdkconfig file.

config FMO_HOST
    string "FMO host name or IPv4 address"
    default "fmo.local"
    help
        LAN address of the FMO device, without ws://, a port, or a path. An IPv4
        address is recommended when the local network does not resolve .local.

config FMO_PORT
    int "FMO web interface port"
    range 1 65535
    default 80

config FMO_BACKLIGHT
    int "Initial display brightness percent"
    range 20 100
    default 80

config FMO_VOLUME
    int "Initial conversation volume percent"
    range 0 100
    default 50
    help
        Auto-play received FMO PCM audio after connection. UP/DOWN changes volume
        by 10 percent; short OK toggles audio and long UP refreshes the channel.
        Volume 0 silences audio. These runtime settings reset on reboot.

config FMO_LCD_HEIGHT
    int "LCD vertical resolution (rows)"
    range 240 280
    default 280
    help
        Your 1.59-inch SPI LCD: most kits are 240x280 (GC9107 / ST7789-compatible).
        If the panel is 240x240, set this to 240 and rebuild. The UI layout
        adapts automatically to both heights.

config FMO_LCD_INVERT
    bool "Invert LCD colors"
    default y
    help
        Some panels ship with an inverted TFT (negative image). If colors look
        inverted, toggle this and rebuild.

config FMO_LCD_GAP_X
    int "LCD column offset (gap X)"
    range 0 40
    default 0
    help
        Row offset used by the panel driver when the controller has no built-in
        offset (common on GC9107). If the picture starts slightly below the top
        edge, increase this.

config FMO_LCD_GAP_Y
    int "LCD row offset (gap Y)"
    range 0 40
    default 0
    help
        Column offset used by the panel driver. If the picture starts slightly
        to the left/right of the active area, adjust this.

config FMO_LCD_MIRROR_X
    bool "Mirror LCD horizontally"
    default n

config FMO_LCD_MIRROR_Y
    bool "Mirror LCD vertically"
    default n

endmenu
```

## sdkconfig.defaults
```kconfig
# --- 目标芯片:ESP32-S3(小智面包板 DIY 套件) ---
CONFIG_IDF_TARGET="esp32s3"
# N16R8 模组:16MB Flash + 8MB Octal PSRAM。PSRAM 供 LVGL/大缓冲使用,
# 音频与网络仍走内部 RAM。
CONFIG_SPIRAM=y
CONFIG_SPIRAM_MODE_OCT=y
CONFIG_SPIRAM_SPEED_80M=y
CONFIG_SPIRAM_USE_MALLOC=y
CONFIG_SPIRAM_MALLOC_ALWAYSINTERNAL=16384
CONFIG_SPIRAM_TRY_ALLOCATE_WIFI_LWIP=y

# --- Flash:16MB(N16R8) ---
CONFIG_ESPTOOLPY_FLASHSIZE_16MB=y
# 固定 16MB 镜像头,便于 idf.py merge-bin。
CONFIG_ESPTOOLPY_HEADER_FLASHSIZE_UPDATE=n
# 分区表沿用原项目(8MB 布局,recovery 分区保留但无固件、不会被跳转)。
CONFIG_PARTITION_TABLE_CUSTOM=y
CONFIG_PARTITION_TABLE_CUSTOM_FILENAME="partitions.csv"
CONFIG_PARTITION_TABLE_FILENAME="partitions.csv"

# Passport 特有:Bootloader 长按 GPIO0 跳 Recovery 的机制已移除(无 Recovery 固件,
# 防止误触 BOOT 键跳入空白分区),相关 CONFIG_BOOTLOADER_FACTORY_RESET 不设置。

# --- 控制台:USB-Serial-JTAG(S3 原生 USB,GPIO19/20) ---
# S3-DevKitC-1 用 Type-C 数据线即可同时烧录与看日志,不占 UART0(GPIO43/44)。
CONFIG_ESP_CONSOLE_USB_SERIAL_JTAG=y
CONFIG_ESP_CONSOLE_SECONDARY_NONE=y

# --- LVGL ---
CONFIG_LV_COLOR_DEPTH_16=y
CONFIG_LV_FONT_MONTSERRAT_14=y
CONFIG_LV_FONT_MONTSERRAT_20=y
CONFIG_LV_FONT_MONTSERRAT_32=y
CONFIG_LV_USE_FONT_COMPRESSED=y
CONFIG_LV_FONT_FMT_TXT_LARGE=n
# 8MB PSRAM 下此值可保持 24KB(内部 RAM),复杂界面卡死时再调大。
CONFIG_LV_MEM_SIZE_KILOBYTES=24
CONFIG_LV_BUILD_EXAMPLES=n
CONFIG_LV_BUILD_DEMOS=n

# --- 系统 ---
CONFIG_FREERTOS_HZ=1000
CONFIG_LWIP_DNS_SUPPORT_MDNS_QUERIES=y

# --- Bluetooth LE / NimBLE ---
# FMO 守听屏不使用蓝牙,保持关闭(与 C3 版一致)。
CONFIG_BT_ENABLED=n
CONFIG_BT_NIMBLE_ENABLED=y
CONFIG_BT_NIMBLE_ROLE_CENTRAL=n
CONFIG_BT_NIMBLE_ROLE_PERIPHERAL=y
CONFIG_BT_NIMBLE_ROLE_BROADCASTER=y
CONFIG_BT_NIMBLE_ROLE_OBSERVER=n
CONFIG_BT_NIMBLE_MAX_CONNECTIONS=1
CONFIG_BT_NIMBLE_HOST_BASED_PRIVACY=n
CONFIG_BT_NIMBLE_NVS_PERSIST=n

CONFIG_LV_USE_QRCODE=y
```
